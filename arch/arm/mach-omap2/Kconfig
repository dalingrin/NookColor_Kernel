## arch/arm/mach-omap2/Kconfig
```kconfig
comment "OMAP Core Type"
	depends on ARCH_OMAP2

config ARCH_OMAP24XX
	bool "OMAP24xx Based System"
	depends on ARCH_OMAP2

config ARCH_OMAP2420
	bool "OMAP2420 support"
	depends on ARCH_OMAP24XX
	select OMAP_DM_TIMER
	select ARCH_OMAP_OTG
	select CPU_V6

config ARCH_OMAP2430
	bool "OMAP2430 support"
	depends on ARCH_OMAP24XX
	select ARCH_OMAP_OTG
	select CPU_V6

config ARCH_OMAP34XX
	bool "OMAP34xx Based System"
	depends on ARCH_OMAP3

config ARCH_OMAP3430
	bool "OMAP3430 support"
	depends on ARCH_OMAP3 && ARCH_OMAP34XX
	select ARCH_OMAP_OTG
	select CPU_V7

comment "OMAP Board Type"
	depends on ARCH_OMAP2 || ARCH_OMAP3

config MACH_OMAP_GENERIC
	bool "Generic OMAP board"
	depends on ARCH_OMAP2 && ARCH_OMAP24XX

config MACH_NOKIA_N800
	bool "Nokia N800"
	depends on ARCH_OMAP2420
	select VIDEO_TCM825X if VIDEO_OMAP2 && VIDEO_HELPER_CHIPS_AUTO
	select CBUS if VIDEO_TCM825X
	select CBUS_RETU if VIDEO_TCM825X
	select MENELAUS if VIDEO_TCM825X
	select OMAP_GPIO_SWITCH

config MACH_NOKIA_N810
	bool "Nokia N810"
	depends on MACH_NOKIA_N800

config MACH_NOKIA_N810_WIMAX
	bool "Nokia N810 WiMAX"
	depends on MACH_NOKIA_N800
	select MACH_NOKIA_N810

config MACH_NOKIA_RX51
	bool "Nokia RX-51 board"
	depends on ARCH_OMAP3 && ARCH_OMAP34XX

config MACH_OMAP2_TUSB6010
	bool
	depends on ARCH_OMAP2 && ARCH_OMAP2420
	default y if MACH_NOKIA_N800

config MACH_OMAP_H4
	bool "OMAP 2420 H4 board"
	depends on ARCH_OMAP2 && ARCH_OMAP2420
	select OMAP_DEBUG_DEVICES

config MACH_OMAP_H4_TUSB
	bool "TUSB 6010 EVM board"
	depends on MACH_OMAP_H4
	select MACH_OMAP2_TUSB6010
	help
	  Set this if you've got a TUSB6010 high speed USB board.
	  You may need to consult the schematics for your revisions
	  of the Menelaus and TUSB boards, and make changes to be
	  sure this is set up properly for your board stack.

	  Be sure to select OTG mode operation, not host-only or
	  peripheral-only.

config MACH_OMAP_H4_OTG
	bool "Use USB OTG connector, not device connector (S1.10)"
	depends on MACH_OMAP_H4
	help
	  Set this if you've set S1.10 (on the mainboard) to use the
	  Mini-AB (OTG) connector and OTG transceiver with the USB0
	  port, instead of the Mini-B ("download") connector with its
	  non-OTG transceiver.

	  Note that the "download" connector can be used to bootstrap
	  the system from the OMAP mask ROM.  Also, since this is a
	  development platform, you can also force the OTG port into
	  a non-OTG operational mode.

config MACH_OMAP2_H4_USB1
	bool "Use USB1 port, not UART2 (S3.3)"
	depends on MACH_OMAP_H4
	help
	  Set this if you've set SW3.3 (on the CPU card) so that the
	  expansion connectors receive USB1 signals instead of UART2.

config MACH_OMAP_APOLLON
	bool "OMAP 2420 Apollon board"
	depends on ARCH_OMAP2 && ARCH_OMAP2420

config MACH_OMAP_2430SDP
	bool "OMAP 2430 SDP board"
	depends on ARCH_OMAP2 && ARCH_OMAP2430

config MACH_OMAP_LDP
	bool "OMAP3 LDP board"
	depends on ARCH_OMAP3 && ARCH_OMAP34XX

config MACH_OMAP_ZOOM2
	bool "OMAP3 ZOOM2 board"
	depends on ARCH_OMAP3 && ARCH_OMAP34XX

config MACH_OMAP3630_EDP1
	bool "OMAP3630 EDP1 board"
	depends on ARCH_OMAP3 && ARCH_OMAP34XX

config MACH_OMAP3621_EDP1
	bool "OMAP3621 EDP1 board"
	depends on ARCH_OMAP3 && ARCH_OMAP34XX

config EDP3_BOARD
	bool "Use EDP3 mainboard"
	depends on MACH_OMAP3621_EDP1 || MACH_OMAP3630_EDP1 || MACH_OMAP3430_EDP1

config MACH_OMAP3621_BOXER
	bool "OMAP3621 BOXER board"
	depends on ARCH_OMAP3 && ARCH_OMAP34XX

config MACH_SDRAM_HYNIX_H8MBX00U0MER0EM_OR_SAMSUNG_K4X4G303PB
	bool "Hynix H8MBX00U0MER0EM DDR memory"
	depends on ARCH_OMAP3 && ARCH_OMAP34XX

config MACH_SDRAM_HYNIX_H8MBX00U0MER0EM
	bool "Hynix H8MBX00U0MER0EM DDR memory"
	depends on ARCH_OMAP3 && ARCH_OMAP34XX

config MACH_SDRAM_SAMSUNG_K4X4G303PB
	bool "Saumsung K4X4G303PB DDR memory"
	depends on ARCH_OMAP3 && ARCH_OMAP34XX

config MACH_SDRAM_ELPIDA_EDD20323ABH
	bool "Elpida EDD20323ABH DDR memory"
	depends on ARCH_OMAP3 && ARCH_OMAP34XX

config MACH_OMAP3621_EVT1A
	bool "OMAP3621 BOXER board revision EVT1A"
	depends on ARCH_OMAP3 && ARCH_OMAP34XX

config MACH_OMAP_ZOOM3
	bool "OMAP3 ZOOM3 board"
	depends on ARCH_OMAP3 && ARCH_OMAP34XX

config ZOOM3_3621
	bool "Use 3621 SOM"
	depends on MACH_OMAP_ZOOM3

config SOM3621_REV1_FIX
	bool "SOM3621 REV1 fix"
	depends on MACH_OMAP_ZOOM3
	help
	   SMC bus is not working on SOM3621 REV1. Fix I/O physical and virtual offsets.

config MACH_OMAP_3630SDP
	bool "OMAP3 3630 SDP board"
	depends on ARCH_OMAP3 && ARCH_OMAP34XX

config L2CACHE_OMAP3_DISABLE
	bool "Disable level 2 cache in Aux cntrl reg"
	depends on ARCH_OMAP3
	help
		Say Y here to disable L2 cache.

choice
	bool "FlexST support"
	depends on MACH_OMAP_ZOOM2 || MACH_OMAP_ZOOM3 || MACH_OMAP_4430SDP
	default MACH_OMAP_FST_OMAP3_127x
	help
	   FlexST will simplify building images for OMAP3+WL127x, OMAP3+WL128x,
	   OMAP4+WL127x, OMAP4+WL128x, and other hardware setups.

config MACH_OMAP_FST_OMAP3_127x
	bool "Enable FlexST for OMAP3+WL127x hardware setup"
	depends on MACH_OMAP_ZOOM2 || MACH_OMAP_ZOOM3

config MACH_OMAP_FST_OMAP3_128x
	bool "Enable FlexST for OMAP3+WL128x hardware setup"
	depends on MACH_OMAP_ZOOM2 || MACH_OMAP_ZOOM3

endchoice

config WIFI_CONTROL_FUNC
        bool "Enable WiFi control function abstraction"
	depends on MACH_OMAP_ZOOM2 || MACH_OMAP_ZOOM3 || MACH_OMAP3630_EDP1 || MACH_OMAP3621_EDP1 || MACH_OMAP3621_BOXER || MACH_OMAP3621_EVT1A
        help
          Enables Power/Reset/Carddetect function abstraction

config TIWLAN_SDIO
	bool "TI WLAN Enhanced SDIO Contoller support"
	depends on MMC_OMAP || MMC_OMAP_MODULE || MMC_OMAP_HS || MMC_OMAP_HS_MODULE
	help
	   Say Y here if you want to be able to use TI's WLAN device using the
	   SDIO interface. If unsure, say N.

config TIWLAN_MMC_CONTROLLER
	int "MMC Controller number that TI WLAN chip is connected to"
	range 1 3
	depends on TIWLAN_SDIO || MMC_EMBEDDED_SDIO
	default "3"
	help
	  Choose the number of the MMC controller that TI WLAN chip is
	  connected to. TI WLAN has SDIO host controller that will control
	  this MMC port.
		  
config MACH_OMAP2EVM 
	bool "OMAP 2530 EVM board"
	depends on ARCH_OMAP2 && ARCH_OMAP24XX

config MACH_OMAP_3430SDP
	bool "OMAP 3430 SDP board"
	depends on ARCH_OMAP3 && ARCH_OMAP34XX

config MACH_OMAP3EVM
	bool "OMAP 3530 EVM board"
	depends on ARCH_OMAP3 && ARCH_OMAP34XX

config MACH_OMAP3_BEAGLE
	bool "OMAP3 BEAGLE board"
	depends on ARCH_OMAP3 && ARCH_OMAP34XX

config MACH_OVERO
	bool "Gumstix Overo board"
	depends on ARCH_OMAP3 && ARCH_OMAP34XX

config MACH_OMAP3_PANDORA
	bool "OMAP3 Pandora"
	depends on ARCH_OMAP3 && ARCH_OMAP34XX

config WLAN_POWER_EVT1
	bool "WLAN power support"
	depends on MACH_OMAP3621_EVT1A
	default "y"
	help
		Has to be set for EVT1A board. 
	
	
```
