## arch/arm/plat-omap/Kconfig
```kconfig
if ARCH_OMAP

menu "TI OMAP Implementations"

config ARCH_OMAP_OTG
	bool

choice
	prompt "OMAP System Type"
	default ARCH_OMAP1

config ARCH_OMAP1
	bool "TI OMAP1"

config ARCH_OMAP2
	bool "TI OMAP2"
	select CPU_V6

config ARCH_OMAP3
	bool "TI OMAP3"
	select CPU_V7

endchoice

comment "OMAP Feature Selections"

choice
	prompt "OMAP3 part type"
	depends on ARCH_OMAP3
	default ARCH_OMAP3_GP

config ARCH_OMAP3_GP
	bool "OMAP3 GP"

config ARCH_OMAP3_HS
	bool "OMAP3 HS/EMU"

endchoice

config OMAP_DEBUG_DEVICES
	bool
	help
	  For debug cards on TI reference boards.

config OMAP_DEBUG_LEDS
	bool
	depends on OMAP_DEBUG_DEVICES
	default y if LEDS || LEDS_OMAP_DEBUG

config OMAP_DEBUG_POWERDOMAIN
	bool "Emit debug messages from powerdomain layer"
	depends on ARCH_OMAP2 || ARCH_OMAP3
	default n
	help
	  Say Y here if you want to compile in powerdomain layer
	  debugging messages for OMAP2/3.   These messages can
	  provide more detail as to why some powerdomain calls
	  may be failing, and will also emit a descriptive message
	  for every powerdomain register write.  However, the
	  extra detail costs some memory.

config OMAP_DEBUG_CLOCKDOMAIN
	bool "Emit debug messages from clockdomain layer"
	depends on ARCH_OMAP2 || ARCH_OMAP3
	default n
	help
	  Say Y here if you want to compile in clockdomain layer
	  debugging messages for OMAP2/3.   These messages can
	  provide more detail as to why some clockdomain calls
	  may be failing, and will also emit a descriptive message
	  for every clockdomain register write.  However, the
	  extra detail costs some memory.

config OMAP_SMARTREFLEX
	bool "SmartReflex support"
	depends on ARCH_OMAP34XX && PM
	help
	  Say Y if you want to enable SmartReflex.

	  SmartReflex can perform continuous dynamic voltage
	  scaling around the nominal operating point voltage
	  according to silicon characteristics and operating
	  conditions. Enabling SmartReflex reduces power
	  consumption.

	  Please note, that by default SmartReflex is only
	  initialized. To enable the automatic voltage
	  compensation for VDD1 and VDD2, user must write 1 to
	  /sys/power/sr_vddX_autocomp, where X is 1 or 2.

config OMAP_SMARTREFLEX_TESTING
	bool "Smartreflex testing support"
	depends on OMAP_SMARTREFLEX
	default n
	help
	  Say Y if you want to enable SmartReflex testing with SW hardcoded
	  NVALUES intead of E-fuse NVALUES set in factory silicon testing.

	  In some devices the E-fuse values have not been set, even though
	  SmartReflex modules are included. Using these hardcoded values set
	  in software, one can test the SmartReflex features without E-fuse.

	  WARNING: Enabling this option may cause your device to hang!

config OMAP_SMARTREFLEX_CLASS1P5
	bool "Use Smartreflex Class 1.5"
	depends on OMAP_SMARTREFLEX
	default n
	help
	   Say Y if you would like to use Smart reflex class 1.5
	   introduces /sys/power/sr_adjust_vsel to
	   view calibrated voltage and set to 0 will restart
	   the calibration cycle

config OMAP_RESET_CLOCKS
	bool "Reset unused clocks during boot"
	depends on ARCH_OMAP
	help
	  Say Y if you want to reset unused clocks during boot.
	  This option saves power, but assumes all drivers are
	  using the clock framework. Broken drivers that do not
	  yet use clock framework may not work with this option.
	  If you are booting from another operating system, you
	  probably do not want this option enabled until your
	  device drivers work properly.

config OMAP_BOOT_TAG
	bool "OMAP bootloader information passing"
        depends on ARCH_OMAP
        default n
        help
          Say Y, if you have a bootloader which passes information
          about your board and its peripheral configuration.

config OMAP_BOOT_REASON
	bool "Support for boot reason"
        depends on OMAP_BOOT_TAG
        default n
        help
          Say Y, if you want to have a procfs entry for reading the boot
          reason in user-space.

config OMAP_COMPONENT_VERSION
	bool "Support for component version display"
	depends on OMAP_BOOT_TAG && PROC_FS
	default n
	help
	  Say Y, if you want to have a procfs entry for reading component
	  versions (supplied by the bootloader) in user-space.

config OMAP_GPIO_SWITCH
	bool "GPIO switch support"
        default n
        help
          Say Y, if you want to have support for reporting of GPIO
          switches (e.g. cover switches) via sysfs. Your bootloader has
          to provide information about the switches to the kernel via the
          ATAG_BOARD mechanism if they're not defined by the board config.

config OMAP_MUX
	bool "OMAP multiplexing support"
        depends on ARCH_OMAP
	default y
        help
          Pin multiplexing support for OMAP boards. If your bootloader
          sets the multiplexing correctly, say N. Otherwise, or if unsure,
          say Y.

config OMAP_MUX_DEBUG
	bool "Multiplexing debug output"
        depends on OMAP_MUX
        help
          Makes the multiplexing functions print out a lot of debug info.
          This is useful if you want to find out the correct values of the
          multiplexing registers.

config OMAP_MUX_WARNINGS
	bool "Warn about pins the bootloader didn't set up"
        depends on OMAP_MUX
        default y
        help
	  Choose Y here to warn whenever driver initialization logic needs
	  to change the pin multiplexing setup.  When there are no warnings
	  printed, it's safe to deselect OMAP_MUX for your product.

config OMAP_MCBSP
	bool "McBSP support"
	depends on ARCH_OMAP
	default y
	help
	  Say Y here if you want support for the OMAP Multichannel
	  Buffered Serial Port.

config OMAP_MBOX_FWK
	tristate "Mailbox framework support"
	depends on ARCH_OMAP
	default n
	help
	  Say Y here if you want to use OMAP Mailbox framework support for
	  DSP, IVA1.0 and IVA2 in OMAP1/2/3.

config OMAP_IOMMU
	tristate "IOMMU support"
	depends on ARCH_OMAP
	default n
	help
	  Say Y here if you want to use OMAP IOMMU support for IVA2 and
	  Camera in OMAP3.

config OMAP_IOMMU_DEBUG
	depends on OMAP_IOMMU
	tristate

choice
        prompt "System timer"
	default OMAP_MPU_TIMER

config OMAP_MPU_TIMER
	bool "Use mpu timer"
	help
	  Select this option if you want to use the OMAP mpu timer. This
	  timer provides more intra-tick resolution than the 32KHz timer,
	  but consumes more power.

config OMAP_32K_TIMER
	bool "Use 32KHz timer"
	depends on ARCH_OMAP16XX || ARCH_OMAP24XX || ARCH_OMAP34XX
	help
	  Select this option if you want to enable the OMAP 32KHz timer.
	  This timer saves power compared to the OMAP_MPU_TIMER, and has
	  support for no tick during idle. The 32KHz timer provides less
	  intra-tick resolution than OMAP_MPU_TIMER. The 32KHz timer is
	  currently only available for OMAP16XX, 24XX and 34XX.

endchoice

config OMAP3_DEBOBS
	bool "OMAP 3430 Debug observability support"
	depends on ARCH_OMAP3 && DEBUG_FS
	default n
	help
	  Use ETK pads for debug observability

config OMAP3_L2_AUX_SECURE_SAVE_RESTORE
	bool "OMAP3 HS/EMU save and restore for L2 AUX control register"
	depends on ARCH_OMAP3 && PM
	default n
	help
	  Without this option, L2 Auxiliary control register contents are
	  lost during off-mode entry on HS/EMU devices. This feature
	  requires support from PPA / boot-loader in HS/EMU devices, which
	  currently does not exist by default.

config OMAP3_L2_AUX_SECURE_SERVICE_SET_ID
	int "Service ID for the support routine to set L2 AUX control"
	depends on OMAP3_L2_AUX_SECURE_SAVE_RESTORE
	default 43
	help
	  PPA routine service ID for setting L2 auxiliary control register.

config OMAP_32K_TIMER_HZ
       int "Kernel internal timer frequency for 32KHz timer"
       range 32 1024
       depends on OMAP_32K_TIMER
       default "128"
       help
	  Kernel internal timer frequency should be a divisor of 32768,
	  such as 64 or 128.

config OMAP_TICK_GPTIMER
	int "GPTIMER used for system tick timer"
	depends on ARCH_OMAP2 || ARCH_OMAP3
	range 1 12
	default 1
	help
	  Linux uses one of the twelve on-board OMAP GPTIMER blocks to generate
	  system tick interrupts.  The twelve GPTIMERs have slightly
	  different powerdomain, source clock, and security properties
	  (mostly documented in the OMAP3 TRMs) that can affect the selection
	  of which GPTIMER to use.  The historical default is GPTIMER1.
	  If CONFIG_OMAP_32K_TIMER is selected, Beagle may require GPTIMER12
	  due to hardware sensitivity to glitches on the OMAP 32kHz clock
	  input.

config OMAP_DM_TIMER
	bool "Use dual-mode timer"
	depends on ARCH_OMAP16XX || ARCH_OMAP24XX || ARCH_OMAP34XX
	help
	 Select this option if you want to use OMAP Dual-Mode timers.

choice
	prompt "Low-level debug console UART"
	depends on ARCH_OMAP
	default OMAP_LL_DEBUG_NONE

config OMAP_LL_DEBUG_UART1
	bool "UART1"

config OMAP_LL_DEBUG_UART2
	bool "UART2"

config OMAP_LL_DEBUG_UART3
	bool "UART3"

config OMAP_LL_DEBUG_UART_EXT
	bool "UART_EXT"

config OMAP_LL_DEBUG_NONE
	bool "None"

endchoice

config OMAP_SERIAL_WAKE
	bool "Enable wake-up events for serial ports"
	depends on OMAP_MUX
	default y
	help
	  Select this option if you want to have your system wake up
	  to data on the serial RX line. This allows you to wake the
	  system from serial console.

comment "USBHOST Port Configuration"
	depends on USB_EHCI_HCD || USB_OHCI_HCD

choice
	prompt "Port 1"
	depends on USB_EHCI_HCD || USB_OHCI_HCD
	default OMAP_EHCI_PHY_MODE_PORT1

config OMAP_EHCI_PHY_MODE_PORT1
	bool "ULPI PHY mode: 12-pin ULPI"
	depends on USB_EHCI_HCD || USB_OHCI_HCD
	help
	  12-pin ULPI PHY Mode. For use with a HS transceiver.

config OMAP_EHCI_TLL_MODE_PORT1
	bool "ULPI TLL mode: 12-pin ULPI"
	depends on USB_EHCI_HCD || USB_OHCI_HCD
	help
	  12-pin ULPI TLL Mode

config OMAP_OHCI_PHY_MODE_3PIN_PORT1
	bool "Serial PHY mode: 3-pin Bi-directional DAT/SE0"
	depends on USB_EHCI_HCD || USB_OHCI_HCD
	help
	  Serial PHY Mode (3-pin Bi-directional DAT/SE0)

config OMAP_OHCI_PHY_MODE_4PIN_PORT1
	bool "Serial PHY mode: 4-pin Bi-directional DP/DM"
	depends on USB_EHCI_HCD || USB_OHCI_HCD
	help
	  Serial PHY Mode (4-pin Bidirectional DP/DM)

endchoice

choice
	prompt "Port 2"
	depends on USB_EHCI_HCD || USB_OHCI_HCD
	default OMAP_EHCI_PHY_MODE_PORT2

config OMAP_EHCI_PHY_MODE_PORT2
	bool "ULPI PHY mode: 12-pin ULPI"
	depends on USB_EHCI_HCD || USB_OHCI_HCD
	help
	  12-pin ULPI PHY Mode

config OMAP_EHCI_TLL_MODE_PORT2
	bool "ULPI TLL mode: 12-pin ULPI"
	depends on USB_EHCI_HCD || USB_OHCI_HCD
	help
	  12-pin ULPI TLL Mode

config OMAP_OHCI_PHY_MODE_3PIN_PORT2
	bool "Serial PHY mode: 3-pin Bi-directional DAT/SE0"
	depends on USB_EHCI_HCD || USB_OHCI_HCD
	help
	  Serial PHY Mode (3-pin Bi-directional DAT/SE0)

config OMAP_OHCI_PHY_MODE_4PIN_PORT2
	bool "Serial PHY mode: 4-pin Bi-directional DP/DM"
	depends on USB_EHCI_HCD || USB_OHCI_HCD
	help
	  Serial PHY Mode (4-pin Bidirectional DP/DM)

endchoice

choice
	prompt "Port 3"
	depends on USB_EHCI_HCD || USB_OHCI_HCD
	default OMAP_OHCI_PHY_MODE_3PIN_PORT3

config OMAP_EHCI_TLL_MODE_PORT3
	bool "ULPI TLL mode: 12-pin ULPI"
	depends on USB_EHCI_HCD || USB_OHCI_HCD
	help
	  12-pin ULPI TLL Mode

config OMAP_OHCI_PHY_MODE_3PIN_PORT3
	bool "Serial PHY mode: 3-pin Bi-directional DAT/SE0"
	depends on USB_EHCI_HCD || USB_OHCI_HCD
	help
	  Serial PHY Mode (3-pin Bidirectional DAT/SE0)

config OMAP_OHCI_PHY_MODE_4PIN_PORT3
	bool "Serial PHY mode: 4-pin Bi-directional DP/DM"
	depends on USB_EHCI_HCD || USB_OHCI_HCD
	help
	  Serial PHY Mode (4-pin Bidirectional DP/DM)

endchoice

choice
	prompt "OMAP PM layer selection"
	depends on ARCH_OMAP
	default OMAP_PM_NOOP

config OMAP_PM_NONE
	bool "No PM layer"

config OMAP_PM_NOOP
	bool "No-op/debug PM layer"

config OMAP_PM_SRF
	depends on PM
	bool "PM layer implemented using SRF"

endchoice

config OMAP3_MPU_L2_CACHE_WORKAROUND
	bool "Enable workaround for lockup on MPU cache corruption"
	depends on ARCH_OMAP3 || PM
	help
	  Workaround replaces MPU RETENTION state with INACTIVE state.
	  Some OMAP3's manufactured before July 2009 suffer from L2
	  cache corruption.  When the MPU fetches a corrupted
	  instruction a system hang or reset via watchdog occurs.  OFF
	  mode is still safe to use.

config VOLTSCALE_VPFORCE
	bool "Voltage scaling using VP force update method"
	depends on ARCH_OMAP3 && PM
	default y
	help
	 Say Y if you want to enable VP force update method
	 of voltage scaling. This is the h/w recomended way
	 of voltage scaling.

	 If not enabled and if OMAP_SMARTREFLEX is enabled
	 vcbypass method will be used for voltage scaling.

config OMAP3_MODEM_AUDIO
	bool "OMAP3 Audio modem"
	depends on ARCH_OMAP34XX && TWL4030_CORE
	help
	   Enable this to support the audio of a modem integrated with OMAP3/TWL5030
endmenu

endif
```

## drivers/media/video/isp/Kconfig
```kconfig
# Kconfig for OMAP3 ISP driver

config VIDEO_OMAP34XX_ISP_PREVIEWER
	tristate "OMAP ISP Previewer"
	depends on !ARCH_OMAP3410 && VIDEO_OMAP3

config VIDEO_OMAP34XX_ISP_RESIZER
	tristate "OMAP ISP Resizer"
	depends on !ARCH_OMAP3410 && VIDEO_OMAP3
```
